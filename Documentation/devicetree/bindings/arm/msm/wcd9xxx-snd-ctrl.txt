## Documentation/devicetree/bindings/arm/msm/wcd9xxx-snd-ctrl.txt
```
Qualcomm WCD9xxx SysFS Sound Controller

This is a SysFS-based analogue of IOCTL sound register read/write
operations handler. It was implemented to simplify the intercommunication
with sound codec registers (so-called lines) and allow to control them
via a basic sysfs entry. It's main purpose is to replace a hacky FauxSound
with an appropriate variant that provides the same functionality.  This
module allows to manipulate with almost every register acquired by codec
implementation with help of its generic interface.

The devicetree representation of WCD9xxx Sound Controller should be:

Required properties:
- compatible:		"qcom,wcd9xxx-snd-ctrl"
- qcom,codec_name:	The name of an expected codec, which is expected to be
			controlled via the sysfs module. A codec with this name
			will be used as global immediately after registration.
- One of the optional properties below: otherwise, there is no sense in
			having Device Tree representation as nothing will
			be set in target sound control data.

Optional properties:
- qcom,mic_line:	Sound line (register) of main microphone.
- qcom,cam_mic_line:	Sound line (register) of camera microphone.
- qcom,speaker_l_line:	Sound line (register) of left speaker channel.
- qcom,speaker_r_line:	Sound line (register) of right speaker channel.
			In case the device has only one main speaker, this
			should be equal to the previous property.
- qcom,headphone_l_line: Sound line (register) of left headphone channel.
- qcom,headphone_r_line: Sound line (register) of right headphone channel.
			In case the device has only one headphone output,
			this should be equal to the previous property.

			Value range of all lines above: 0 - 0x3FF.

- qcom,default_gain:	Default sound gains for all the lines (registers).
			Note that if some of the lines are not set, the
			value must be written anyway. It just won't be
			applied at the moment expected control data is
			registered.

			default_gain is represented as a 6-char array.
			Each member adduces itself as a one of the values
			for the registers defined previously:

			[0] --> mic_line,
			[1] --> cam_mic_line,
			[2] --> speaker_l_line,
			[3] --> speaker_r_line,
			[4] --> headphone_l_line,
			[5] --> headphone_r_line;

			As you can see, values go straight in the same
			order the registers are defined. Again, if some of
			the registers are not set, a value must be set
			anyway. You can make it zero, for example.

			Value range of all gains above: 0 - 256.

Example:
	qcom,wcd9xxx-snd-ctrl {
		compatible = "qcom,wcd9xxx-snd-ctrl"
		qcom,codec_name = "taiko_codec";
		qcom,mic_line = <0x251>;
		qcom,cam_mic_line = <0x249>;
		qcom,speaker_l_line = <0x2e7>;
		qcom,speaker_r_line = <0x2e7>;
		qcom,headphone_l_line = <0x2b7>;
		qcom,headphone_r_line = <0x2bf>;
		qcom,default_gain = <5 5 8 8 3 3>;
	};
```

## drivers/video/msm/mdss/Kconfig
```kconfig
config FB_MSM_MDSS_WRITEBACK
	bool "MDSS Writeback Panel"
	---help---
	The MDSS Writeback Panel provides support for routing the output of
	MDSS frame buffer driver and MDP processing to memory.

config FB_MSM_MDSS_KCAL_CTRL
	depends on FB_MSM_MDSS
	bool "MDSS color control"
	default y
	---help---
	  Enable sysfs for post-processing control of mdss-mdp5 display
	  controllers in MDSS.
```
